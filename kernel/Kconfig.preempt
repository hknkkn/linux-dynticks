## kernel/Kconfig.preempt
```kconfig
choice
	prompt "Preemption Model"
	default PREEMPT_NONE

config PREEMPT_NONE
	bool "No Forced Preemption (Server)"
	help
	  This is the traditional Linux preemption model, geared towards
	  throughput. It will still provide good latencies most of the
	  time, but there are no guarantees and occasional longer delays
	  are possible.

	  Select this option if you are building a kernel for a server or
	  scientific/computation system, or if you want to maximize the
	  raw processing power of the kernel, irrespective of scheduling
	  latencies.

config PREEMPT_VOLUNTARY
	bool "Voluntary Kernel Preemption (Desktop)"
	help
	  This option reduces the latency of the kernel by adding more
	  "explicit preemption points" to the kernel code. These new
	  preemption points have been selected to reduce the maximum
	  latency of rescheduling, providing faster application reactions,
	  at the cost of slightly lower throughput.

	  This allows reaction to interactive events by allowing a
	  low priority process to voluntarily preempt itself even if it
	  is in kernel mode executing a system call. This allows
	  applications to run more 'smoothly' even when the system is
	  under load.

	  Select this if you are building a kernel for a desktop system.

config PREEMPT
	bool "Preemptible Kernel (Low-Latency Desktop)"
	select PREEMPT_COUNT
	select UNINLINE_SPIN_UNLOCK if !ARCH_INLINE_SPIN_UNLOCK
	help
	  This option reduces the latency of the kernel by making
	  all kernel code (that is not executing in a critical section)
	  preemptible.  This allows reaction to interactive events by
	  permitting a low priority process to be preempted involuntarily
	  even if it is in kernel mode executing a system call and would
	  otherwise not be about to reach a natural preemption point.
	  This allows applications to run more 'smoothly' even when the
	  system is under load, at the cost of slightly lower throughput
	  and a slight runtime overhead to kernel code.

	  Select this if you are building a kernel for a desktop or
	  embedded system with latency requirements in the milliseconds
	  range.

endchoice

config PREEMPT_COUNT
       bool



menu "Kernel Mode Linux"

config KERNEL_MODE_LINUX
        bool "Kernel Mode Linux"
        ---help---
          This enables Kernel Mode Linux. In Kernel Mode Linux, user programs
          can be executed safely in kernel mode and access a kernel address space
          directly. Thus, for example, costly mode switching between a user and a kernel
          can be eliminated. If you say Y here, the kernel enables Kernel Mode Linux.

          More information about Kernel Mode Linux can be found in the
          <file:Documentation/kml.txt>

          If you don't know what to do here, say N.

config KML_CHECK_CHROOT
        bool "Check for chroot"
        default y
        depends on KERNEL_MODE_LINUX
        ---help---
          This enables the check for the current root file system being chrooted
          when executing user processes in kernel mode. In the current KML
          implementation, programs in the dicretory "/trusted" are executed in
          kernel mode. Therefore, the chroot check is necessary because,
          if the root file system is chrooted to "/home/foo/",
          programs in the directory "/home/foo/trusted" are accidentally executed in kernel mode.

          If you don't know what to do here, say Y.

comment "Safety check have not been implemented"
depends on KERNEL_MODE_LINUX

endmenu
```
